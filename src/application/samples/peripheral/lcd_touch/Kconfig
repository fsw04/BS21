## src/application/samples/peripheral/lcd_touch/Kconfig
```kconfig
#===============================================================================
# @brief    Kconfig file.
# Copyright (c) HiSilicon (Shanghai) Technologies Co., Ltd. 2024-2024. All rights reserved.
#===============================================================================

# ==================== LCD SPI 配置 ====================
config LCD_SPI_BUS_ID
    int
    prompt "LCD SPI bus id."
    depends on SAMPLE_SUPPORT_LCD_TOUCH
    default 2

config LCD_SPI_CLK_PIN
    int
    prompt "LCD SPI CLK pin."
    depends on SAMPLE_SUPPORT_LCD_TOUCH
    default 14

config LCD_SPI_CLK_PIN_MODE
    int
    prompt "LCD SPI CLK pin mode."
    depends on SAMPLE_SUPPORT_LCD_TOUCH
    default 2

config LCD_SPI_MOSI_PIN
    int
    prompt "LCD SPI MOSI pin."
    depends on SAMPLE_SUPPORT_LCD_TOUCH
    default 11

config LCD_SPI_MOSI_PIN_MODE
    int
    prompt "LCD SPI MOSI pin mode."
    depends on SAMPLE_SUPPORT_LCD_TOUCH
    default 2

config LCD_SPI_CS_PIN
    int
    prompt "LCD SPI CS pin (GPIO control)."
    depends on SAMPLE_SUPPORT_LCD_TOUCH
    default 12

config LCD_SPI_CS_PIN_MODE
    int
    prompt "LCD SPI CS pin mode."
    depends on SAMPLE_SUPPORT_LCD_TOUCH
    default 0

config LCD_DC_PIN
    int
    prompt "LCD DC (Data/Command) pin."
    depends on SAMPLE_SUPPORT_LCD_TOUCH
    default 13

config LCD_RST_PIN
    int
    prompt "LCD Reset pin."
    depends on SAMPLE_SUPPORT_LCD_TOUCH
    default 15

config LCD_BL_PIN
    int
    prompt "LCD Backlight pin."
    depends on SAMPLE_SUPPORT_LCD_TOUCH
    default 16

# ==================== 触摸 I2C 配置 ====================
config TOUCH_I2C_BUS_ID
    int
    prompt "Touch I2C bus id."
    depends on SAMPLE_SUPPORT_LCD_TOUCH
    default 0

config TOUCH_I2C_SCL_PIN
    int
    prompt "Touch I2C SCL pin."
    depends on SAMPLE_SUPPORT_LCD_TOUCH
    default 25

config TOUCH_I2C_SCL_PIN_MODE
    int
    prompt "Touch I2C SCL pin mode."
    depends on SAMPLE_SUPPORT_LCD_TOUCH
    default 1

config TOUCH_I2C_SDA_PIN
    int
    prompt "Touch I2C SDA pin."
    depends on SAMPLE_SUPPORT_LCD_TOUCH
    default 26

config TOUCH_I2C_SDA_PIN_MODE
    int
    prompt "Touch I2C SDA pin mode."
    depends on SAMPLE_SUPPORT_LCD_TOUCH
    default 1

config TOUCH_INT_PIN
    int
    prompt "Touch Interrupt pin (-1 for unused)."
    depends on SAMPLE_SUPPORT_LCD_TOUCH
    default 27

config TOUCH_RST_PIN
    int
    prompt "Touch Reset pin (-1 for unused)."
    depends on SAMPLE_SUPPORT_LCD_TOUCH
    default 28
```

## src/application/samples/peripheral/st7796s_ft6336u/Kconfig
```kconfig
#===============================================================================
# @brief    ST7796S LCD + FT6336U touch + SLE 1VN health monitor configuration
#===============================================================================

#-------------------------------------------------------------------------------
# LCD 配置
#-------------------------------------------------------------------------------
config ST7796S_LCD_BL_ENABLE
    bool
    prompt "Drive ST7796S LCD backlight GPIO high."
    depends on SAMPLE_SUPPORT_ST7796S_FT6336U
    default y

config ST7796S_MADCTL
    hex
    prompt "ST7796S MADCTL value."
    depends on SAMPLE_SUPPORT_ST7796S_FT6336U
    default 0x28

#-------------------------------------------------------------------------------
# 触控配置
#-------------------------------------------------------------------------------
config FT6336U_USE_INT_PIN
    bool
    prompt "Configure FT6336U INT pin as input."
    depends on SAMPLE_SUPPORT_ST7796S_FT6336U
    default n

#-------------------------------------------------------------------------------
# SLE 1VN 服务端配置
#-------------------------------------------------------------------------------
config ST7796S_SLE_1VN_ENABLE
    bool
    prompt "Enable SLE 1VN server functionality."
    depends on SAMPLE_SUPPORT_ST7796S_FT6336U
    default y

config SLE_1VN_SERVER_MAC_ADDR
    hex
    default 0x787060889647
    prompt "Set the SLE 1VN server MAC address."
    depends on ST7796S_SLE_1VN_ENABLE

config SLE_1VN_SERVER_ID
    int
    range 0 99
    default 1
    prompt "Set the watch ID of SLE 1VN server."
    depends on ST7796S_SLE_1VN_ENABLE

config SLE_1VN_SERVER_NAME_PREFIX
    string
    prompt "Set the advertised name prefix of SLE 1VN server."
    default "watch"
    depends on ST7796S_SLE_1VN_ENABLE

#-------------------------------------------------------------------------------
# 字体配置
#-------------------------------------------------------------------------------
config FONT_HZK16_ENABLE
    bool
    prompt "Enable HZK16 Chinese font support (requires ~260KB flash)."
    depends on SAMPLE_SUPPORT_ST7796S_FT6336U
    default n
    help
        Enable this to include the HZK16 16x16 Chinese font data.
        When disabled, Chinese characters are rendered as placeholder blocks.
        The HZK16 binary file must be provided separately and linked
        via CMake objcopy or included as a C array.
```

## src/application/samples/sle_1vn/Kconfig
```kconfig
#===============================================================================
# @brief    Kconfig file for SLE 1VN Server
# Copyright (c) HiSilicon (Shanghai) Technologies Co., Ltd. 2023-2023. All rights reserved.
#===============================================================================

config SLE_1VN_SERVER_MAC_ADDR
    hex
    default 0x787060889647
    prompt "Set the BS21E SLE 1VN server MAC address."
    depends on ENABLE_SLE_1VN
    help
        This option means the MAC address of the SLE 1VN server.

config SLE_1VN_SERVER_ID
    int
    range 0 99
    default 1
    prompt "Set the watch ID of SLE 1VN server."
    depends on ENABLE_SLE_1VN
    help
        This option means the numeric ID appended to the advertised SLE name.
        The client can scan this server by the complete local name watch-xx.

config SLE_1VN_SERVER_NAME_PREFIX
    string
    prompt "Set the advertised name prefix of SLE 1VN server."
    default "watch"
    depends on ENABLE_SLE_1VN
    help
        This option means the prefix of the SLE 1VN server name.
        The final advertised name is prefix-ID, such as watch-01.
```
